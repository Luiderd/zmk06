## boards/shields/corney/Kconfig.shield
```kconfig
# Copyright (c) 2020 Pete Johanson
# SPDX-License-Identifier: MIT

config SHIELD_CORNEY_LEFT
    def_bool $(shields_list_contains,corney_left)

config SHIELD_CORNEY_RIGHT
    def_bool $(shields_list_contains,corney_right)
```
